## yocto/meta-cse/conf/layer.conf
```bitbake
BBPATH .= ":${LAYERDIR}"
BBFILES += "${LAYERDIR}/recipes-*/*/*.bb ${LAYERDIR}/recipes-*/*/*.bbappend"

BBFILE_COLLECTIONS += "cse"
BBFILE_PATTERN_cse = "^${LAYERDIR}/"
BBFILE_PRIORITY_cse = "10"

LAYERDEPENDS_cse = "core raspberrypi"
LAYERSERIES_COMPAT_cse = "wrynose"
```
